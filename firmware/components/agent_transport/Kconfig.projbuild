## firmware/components/agent_transport/Kconfig.projbuild
```kconfig
menu "P4Home Agent Transport"

config P4HOME_AGENT_TRANSPORT_ENABLED
    bool "Enable P4 Agent Device WebSocket transport"
    default n

config P4HOME_AGENT_TRANSPORT_URI
    string "Agent Device WebSocket URI"
    default ""
    depends on P4HOME_AGENT_TRANSPORT_ENABLED
    help
        Must be a wss:// URI ending in /v1/device.

config P4HOME_AGENT_DEVICE_ID
    string "Paired P4 device id"
    default ""
    depends on P4HOME_AGENT_TRANSPORT_ENABLED

config P4HOME_AGENT_DEVICE_TOKEN
    string "Paired P4 device token"
    default ""
    depends on P4HOME_AGENT_TRANSPORT_ENABLED
    help
        Development provisioning only. Production provisioning should supply
        the token through agent_transport_init() from protected storage.

config P4HOME_AGENT_SPKI_SHA256
    string "Agent TLS SPKI SHA-256 pin (64 lowercase hex characters)"
    default ""
    depends on P4HOME_AGENT_TRANSPORT_ENABLED

config P4HOME_AGENT_PROTOCOL_VERSION
    int "Selected Device Protocol version"
    range 1 2
    default 1
    depends on P4HOME_AGENT_TRANSPORT_ENABLED
    help
        Keep 1 for the frozen room-level protocol. Select 2 only when the
        paired Agent Runtime supports the Phase 3 object runtime contract.

config P4HOME_AGENT_TRANSPORT_TASK_STACK
    int "Agent transport worker stack bytes"
    range 6144 16384
    default 12288
    depends on P4HOME_AGENT_TRANSPORT_ENABLED

endmenu
```

## firmware/components/audio_service/Kconfig.projbuild
```kconfig
menu "P4Home Audio Service"

config P4HOME_AUDIO_STARTUP_SELFTEST
    bool "Run audio startup tone and microphone selftest"
    default n

config P4HOME_PHASE5A_VALIDATION
    bool "Enable Phase 5A voice baseline validation markers"
    default n
    depends on P4HOME_SR_ENABLE && P4HOME_AUDIO_STARTUP_SELFTEST

endmenu
```

## firmware/components/board_support/Kconfig.projbuild
```kconfig
menu "P4Home Runtime Scope"

config P4HOME_SR_ENABLE
    bool "Enable speech recognition runtime"
    default n

config P4HOME_GATEWAY_RUNTIME_POLL_ENABLE
    bool "Enable gateway runtime polling loop"
    default n

config P4HOME_BACKGROUND_TASKS_EXTERNAL_STACK
    bool "Place persistent background task stacks in external RAM"
    depends on FREERTOS_TASK_CREATE_ALLOW_EXT_MEM
    default n
    help
        Keeps the persistent weather and energy worker stacks out of scarce
        internal DMA-capable RAM. Enable only on targets with reliable PSRAM.

endmenu
```

## firmware/components/sr_service/Kconfig.projbuild
```kconfig
menu "P4 Home speech recognition models"

    config P4HOME_SR_WAKE_SENSITIVE
        bool "Use WakeNet high-sensitivity detection mode"
        default n
        help
            Use the model's DET_MODE_95 operating point instead of the AFE
            default. May reduce missed wakes but may also increase false wakes.
            Does not change microphone gain or the playback suppression gate.

    config P4HOME_SR_INPUT_DIAGNOSTICS
        bool "Log bounded microphone and wake-gate diagnostics"
        default n
        help
            Every five seconds, log aggregate input level, clipping, delivered
            sample rate and WakeNet gate state. Does not retain microphone PCM.

    # ESP-SR 2.1.4 ships this WakeNet9 model but omits its Kconfig entry.
    # Keep the upstream symbol name so the ESP-SR model packer resolves the
    # bundled model/wakenet_model/wn9_hixiaoxing_tts directory.
    config SR_WN_WN9_HIXIAOXING_TTS
        bool "Hi,小星 (wn9_hixiaoxing_tts)"
        depends on IDF_TARGET_ESP32S3 || IDF_TARGET_ESP32P4 || IDF_TARGET_ESP32
        default n

endmenu
```

## firmware/components/ui_pages/Kconfig.projbuild
```kconfig
menu "P4Home UI Pages"

config P4HOME_DASHBOARD_COLUMNS
    int "Dashboard columns"
    range 1 6
    default 3

config P4HOME_DASHBOARD_DEFAULT_PAGE
    string "Default dashboard group"
    default ""

config P4HOME_DASHBOARD_STALE_VISUAL
    bool "Dim stale dashboard cards"
    default y

config P4HOME_UI_STATUS_BANNER_HEIGHT
    int "Dashboard status banner height"
    range 24 72
    default 36

config P4HOME_UI_STATUS_BANNER_ENABLE_IP_SUFFIX
    bool "Show IP suffix in banner"
    default y

config P4HOME_UI_PIXEL_CRT_OVERLAY
    bool "Pixel home CRT scanline overlay"
    default y
    help
        Tiles a static scanline pattern over the pixel home page. It is drawn
        once and never animated, so it costs nothing per frame, but it changes
        the page from a widget dashboard into a game screen. Turn it off to
        compare on real hardware, where panel gamma may make it too dark.

endmenu
```

## firmware/components/voice_transport/Kconfig.projbuild
```kconfig
menu "P4Home Voice Transport"

config P4HOME_VOICE_TRANSPORT_ENABLED
    bool "Enable independent Voice Protocol WebSocket transport"
    depends on P4HOME_SR_ENABLE
    default n

config P4HOME_VOICE_TRANSPORT_URI
    string "Agent Voice WebSocket URI"
    default ""
    depends on P4HOME_VOICE_TRANSPORT_ENABLED
    help
        Must be a wss:// URI ending in /v1/voice.

config P4HOME_VOICE_DEVICE_ID
    string "Paired P4 device id reused by Voice transport"
    default ""
    depends on P4HOME_VOICE_TRANSPORT_ENABLED

config P4HOME_VOICE_DEVICE_TOKEN
    string "Paired P4 device token reused by Voice transport"
    default ""
    depends on P4HOME_VOICE_TRANSPORT_ENABLED

config P4HOME_VOICE_SPKI_SHA256
    string "Voice TLS SPKI SHA-256 pin"
    default ""
    depends on P4HOME_VOICE_TRANSPORT_ENABLED

config P4HOME_VOICE_TRANSPORT_TASK_STACK
    int "Voice transport worker stack bytes"
    range 8192 16384
    default 12288
    depends on P4HOME_VOICE_TRANSPORT_ENABLED

config P4HOME_VOICE_WEBSOCKET_TASK_STACK
    int "Voice WebSocket internal task stack bytes"
    range 6144 12288
    default 8192
    depends on P4HOME_VOICE_TRANSPORT_ENABLED

endmenu
```

## firmware/components/weather_service/Kconfig.projbuild
```kconfig
menu "P4Home Weather Service"

config P4HOME_WEATHER_ENABLE
    bool "Fetch public weather data for dashboard"
    default y

config P4HOME_WEATHER_LATITUDE
    string "Weather latitude"
    default "31.2304"

config P4HOME_WEATHER_LONGITUDE
    string "Weather longitude"
    default "121.4737"

config P4HOME_WEATHER_TIMEZONE
    string "Weather timezone"
    default "Asia/Shanghai"

config P4HOME_WEATHER_USE_TLS
    bool "Use HTTPS for public weather API"
    default n
    help
        Keep this disabled for field validation on networks where SNTP or TLS
        handshakes are unreliable. Enable it when public Internet time sync is
        stable and certificate validation is desired.

config P4HOME_WEATHER_REFRESH_MS
    int "Weather refresh interval (ms)"
    range 300000 86400000
    default 1800000

config P4HOME_WEATHER_CONNECT_TIMEOUT_MS
    int "Weather HTTP timeout (ms)"
    range 1000 30000
    default 7000

config P4HOME_WEATHER_HTTP_MAX_BYTES
    int "Weather HTTP max response bytes"
    range 2048 32768
    default 8192

config P4HOME_WEATHER_PANEL_ENTITY_ID
    string "Dashboard weather entity id"
    default "weather.forecast_wo_de_jia"

endmenu
```
