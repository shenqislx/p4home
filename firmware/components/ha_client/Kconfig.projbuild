## firmware/components/ha_client/Kconfig.projbuild
```kconfig
menu "P4Home HA Client"

config P4HOME_HA_CLIENT_HANDSHAKE_TIMEOUT_MS
    int "Handshake wait timeout (ms)"
    range 1000 60000
    default 10000

config P4HOME_HA_CLIENT_NET_WAIT_MS
    int "Wi-Fi wait before HA dial (ms)"
    range 1000 60000
    default 10000

config P4HOME_HA_CLIENT_TIME_WAIT_MS
    int "Time sync wait before TLS dial (ms)"
    range 0 60000
    default 10000

config P4HOME_HA_CLIENT_START_DELAY_MS
    int "Delay before first HA dial after boot (ms)"
    range 0 120000
    default 30000

config P4HOME_HA_CLIENT_BUFFER_SIZE
    int "WebSocket buffer size"
    range 1024 32768
    default 4096

config P4HOME_HA_CLIENT_WORKER_STACK
    int "HA worker task stack size"
    range 8192 32768
    default 12288

config P4HOME_HA_CLIENT_WS_TASK_STACK
    int "HA WebSocket internal task stack size"
    range 6144 32768
    default 8192

config P4HOME_HA_CLIENT_INITIAL_STATES_TIMEOUT_MS
    int "Initial states timeout (ms)"
    range 1000 60000
    default 10000

config P4HOME_HA_CLIENT_MAX_EVENT_JSON_BYTES
    int "Max inbound HA event JSON bytes"
    range 2048 65536
    default 8192

config P4HOME_HA_CLIENT_RECONNECT_BASE_MS
    int "Reconnect base backoff (ms)"
    range 250 10000
    default 1000

config P4HOME_HA_CLIENT_RECONNECT_MAX_MS
    int "Reconnect max backoff (ms)"
    range 1000 120000
    default 60000

config P4HOME_HA_CLIENT_RECONNECT_JITTER_PCT
    int "Reconnect jitter percent"
    range 0 50
    default 20

config P4HOME_HA_METRICS_HEARTBEAT
    bool "Log HA metrics on heartbeat"
    default y

endmenu
```

## firmware/components/network_service/Kconfig.projbuild
```kconfig
menu "P4Home Network Service"

config P4HOME_WIFI_SSID
    string "Wi-Fi SSID"
    default ""

config P4HOME_WIFI_PASSWORD
    string "Wi-Fi password"
    default ""

config P4HOME_WIFI_MAX_RETRY
    int "Fast retry count before slow retry"
    range 0 32
    default 5

config P4HOME_WIFI_AUTOSTART
    bool "Autostart Wi-Fi station on boot"
    default y

config P4HOME_WIFI_VERIFY_WAIT_MS
    int "Startup Wi-Fi verify wait (ms)"
    range 0 60000
    default 3000

config P4HOME_WIFI_STATIC_IP_ENABLE
    bool "Enable static IPv4 for Wi-Fi STA debug"
    default n

if P4HOME_WIFI_STATIC_IP_ENABLE

config P4HOME_WIFI_STATIC_IP_ADDR
    string "Static IPv4 address"
    default "192.168.1.50"

config P4HOME_WIFI_STATIC_IP_NETMASK
    string "Static IPv4 netmask"
    default "255.255.255.0"

config P4HOME_WIFI_STATIC_IP_GATEWAY
    string "Static IPv4 gateway"
    default "192.168.1.1"

config P4HOME_WIFI_STATIC_IP_DNS1
    string "Static IPv4 primary DNS"
    default "192.168.1.1"

config P4HOME_WIFI_STATIC_IP_DNS2
    string "Static IPv4 secondary DNS"
    default "8.8.8.8"

endif

endmenu
```

## firmware/components/panel_data_store/Kconfig.projbuild
```kconfig
menu "P4Home Panel Data Store"

config P4HOME_PANEL_STORE_MAX_ENTITIES
    int "Max panel entities"
    range 1 128
    default 32

config P4HOME_PANEL_STORE_STALE_MS
    int "Stale threshold (ms)"
    range 1000 3600000
    default 300000

config P4HOME_PANEL_STORE_HISTORY_POINTS
    int "Numeric history points per panel entity"
    range 4 48
    default 12

config P4HOME_PANEL_STORE_SAMPLE_INTERVAL_MS
    int "Numeric history sample interval (ms)"
    range 1000 86400000
    default 3600000

config P4HOME_PANEL_STORE_AUTOSTART
    bool "Autoregister HA callback on init"
    default y

config P4HOME_ENTITY_WHITELIST_EMBEDDED
    bool "Use embedded panel whitelist JSON"
    default y

config P4HOME_ENTITY_WHITELIST_MAX_ENTITIES
    int "Max whitelist entries"
    range 1 128
    default 32

endmenu
```

## firmware/components/settings_service/Kconfig.projbuild
```kconfig
menu "P4Home Settings Service"

config P4HOME_HA_URL
    string "Home Assistant base URL"
    default ""

config P4HOME_HA_TOKEN
    string "Home Assistant long-lived token"
    default ""

config P4HOME_HA_VERIFY_TLS
    bool "Verify Home Assistant TLS certificate"
    default y

config P4HOME_HA_SEED_NVS_ON_BOOT
    bool "Seed HA config from Kconfig into NVS on boot"
    default y

endmenu
```

## firmware/components/time_service/Kconfig.projbuild
```kconfig
menu "P4Home Time Service"

config P4HOME_TIME_ENABLE
    bool "Enable time service"
    default y

config P4HOME_TIME_TZ
    string "Time zone"
    default "CST-8"

config P4HOME_TIME_WAIT_WIFI_MS
    int "Wi-Fi wait before SNTP start (ms)"
    range 1000 300000
    default 60000

config P4HOME_TIME_SYNC_WAIT_MS
    int "Startup time sync wait (ms)"
    range 0 60000
    default 5000

config P4HOME_TIME_SYNC_RETRY_MS
    int "Retry delay after SNTP startup failure (ms)"
    range 1000 60000
    default 5000

config P4HOME_TIME_NTP_SERVER_0
    string "NTP server 0"
    default "pool.ntp.org"

config P4HOME_TIME_NTP_SERVER_1
    string "NTP server 1"
    default "ntp.ntsc.ac.cn"

config P4HOME_TIME_NTP_SERVER_2
    string "NTP server 2"
    default "cn.pool.ntp.org"

endmenu
```
